## boards/shields/egs/Kconfig.defconfig
```kconfig
# Copyright (c) 2026 The EGS_W1 Project Contributor
# SPDX-License-Identifier: MIT

if SHIELD_EGS_LEFT || SHIELD_EGS_RIGHT

config SHIELD
    string
    default "egs"

config ZMK_SPLIT
    bool
    default y

config ZMK_PHYSICAL_LAYOUT
    bool                       # <--- Added type declaration
    default y

config KEYBOARD_NAME
    string                     # <--- Added type declaration
    default "EGS_W1"

endif
```

## boards/shields/egs/Kconfig.shield
```kconfig
# Copyright (c) 2026 The EGS_W1 Project Contributor
# SPDX-License-Identifier: MIT

config SHIELD_EGS_LEFT
    def_bool $(shields_list_contains,egs_left)

config SHIELD_EGS_RIGHT
    def_bool $(shields_list_contains,egs_right)
```

## config/boards/shields/egs/Kconfig.defconfig
```kconfig
# Copyright (c) 2026 The EGS_W1 Project
# SPDX-License-Identifier: MIT

if SHIELD_EGS_LEFT || SHIELD_EGS_RIGHT

    config SHIELD
        string
        default "egs"

    config ZMK_KEYBOARD_NAME
        string
        default "EGS_W1"

    config ZMK_SPLIT
        bool
        default y

    config ZMK_USB
        bool
        default y

    config CONFIG_ZMK_HID_INDICATORS
        bool
        dafault y

if SHIELD_EGS_LEFT

    config ZMK_SPLIT_ROLE_CENTRAL
        default y

endif # SHIELD_EGS_LEFT

endif # SHIELD_EGS_LEFT || SHIELD_EGS_RIGHT
```
