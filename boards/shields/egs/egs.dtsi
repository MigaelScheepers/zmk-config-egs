/*
 * Copyright (c) 2026 The EGS_W1 Project Contributor
 * SPDX-License-Identifier: MIT
 */

#include <dt-bindings/zmk/matrix_transform.h>
#include "egs-layout.dtsi"

/ {
    chosen {
        zmk,physical-layout = &default_layout;
    };
};