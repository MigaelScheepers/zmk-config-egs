/*
 * Copyright (c) 2026 The EGS_W1 Project
 * SPDX-License-Identifier: MIT
 */

 # include "egs.dtsi"

&kscan0 {
	col-gpios
		= <&pro_micro 7 GPIO_ACTIVE_HIGH>
		, <&pro_micro 8 GPIO_ACTIVE_HIGH>
		, <&pro_micro 9 GPIO_ACTIVE_HIGH>
		, <&pro_micro 10 GPIO_ACTIVE_HIGH>
		, <&pro_micro 16 GPIO_ACTIVE_HIGH>
		, <&pro_micro 14 GPIO_ACTIVE_HIGH>
		;
};

&left_encoder {
	status = "okay";
};
